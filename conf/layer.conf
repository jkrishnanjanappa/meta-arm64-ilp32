## conf/layer.conf
```bitbake
BBPATH ?= ""
# We have a conf and classes directory, add to BBPATH
BBPATH := "${LAYERDIR}:${BBPATH}"

# We have an images and various recipe-* directories, add to BBFILES
BBFILES += "${LAYERDIR}/recipes/*/*.bb ${LAYERDIR}/recipes*/*/*.bb"
BBFILES += "${LAYERDIR}/recipes/*/*.bbappend ${LAYERDIR}/recipes*/*/*.bbappend"
	
BBFILE_COLLECTIONS += "arm64-ilp32"
BBFILE_PATTERN_arm64-ilp32 := "^${LAYERDIR}/"
BBFILE_PRIORITY_arm64-ilp32 = "6"

LAYERSERIES_COMPAT_arm64-ilp32 = "rocko"

LINUXLIBCVERSION ?= "4.14%"
```

## conf/machine/include/arm/arch-multilib-ilp32.inc
```bitbake
require conf/multilib.conf
MULTILIBS = "multilib:lib32"
DEFAULTTUNE_virtclass-multilib-lib32 = "aarch64_ilp32"
TARGET_LD_ARCH_virtclass-multilib-lib32 += " -m aarch64linux32 "
```

## conf/machine/include/arm64/arch-multilib-ilp32.inc
```bitbake
require conf/multilib.conf
MULTILIBS = "multilib:lib32"
DEFAULTTUNE_virtclass-multilib-lib32 = "aarch64_ilp32"
ALTBINDIR_SUFFIX_virtclass-multilib-lib32 = "32"
TARGET_LD_ARCH_virtclass-multilib-lib32 += " -m aarch64linux32 "
```
